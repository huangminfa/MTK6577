global &project
&project="mt6577_evb"
debug.PollingTime   100.ms
